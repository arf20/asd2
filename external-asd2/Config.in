## external-asd2/Config.in
```kconfig
source "$BR2_EXTERNAL_asd2_PATH/package/sinit/Config.in"
source "$BR2_EXTERNAL_asd2_PATH/package/skeleton-init-sinit/Config.in"
source "$BR2_EXTERNAL_asd2_PATH/package/sbase/Config.in"
source "$BR2_EXTERNAL_asd2_PATH/package/ubase/Config.in"
source "$BR2_EXTERNAL_asd2_PATH/package/smdev/Config.in"
source "$BR2_EXTERNAL_asd2_PATH/package/nldev/Config.in"
source "$BR2_EXTERNAL_asd2_PATH/package/nlmon/Config.in"
source "$BR2_EXTERNAL_asd2_PATH/package/svc/Config.in"
```

## external-asd2/configs/asd2-pc_x86_64_bios_defconfig
```kconfig
BR2_x86_64=y
BR2_TOOLCHAIN_BUILDROOT_MUSL=y
BR2_CCACHE=y
BR2_TARGET_GENERIC_HOSTNAME="asd2"
BR2_TARGET_GENERIC_ISSUE="Welcome to ARF Software Distribution Version 2"
BR2_INIT_SINIT=y
BR2_ROOTFS_MERGED_USR=y
BR2_ROOTFS_MERGED_BIN=y
BR2_TARGET_GENERIC_ROOT_PASSWD="asd2"
BR2_SYSTEM_BIN_SH_MKSH=y
BR2_SYSTEM_DEFAULT_PATH="/bin:/sbin:/usr/bin:/usr/sbin"
BR2_ROOTFS_OVERLAY="$(BR2_EXTERNAL_asd2_PATH)/board/asd2-x86_64/overlay/"
BR2_LINUX_KERNEL=y
BR2_LINUX_KERNEL_USE_CUSTOM_CONFIG=y
BR2_LINUX_KERNEL_CUSTOM_CONFIG_FILE="$(BR2_EXTERNAL_asd2_PATH)/board/asd2-x86_64/linux.config"
# BR2_PACKAGE_BUSYBOX is not set
BR2_PACKAGE_BZIP2=y
BR2_PACKAGE_GZIP=y
BR2_PACKAGE_XZ=y
BR2_PACKAGE_ZSTD=y
BR2_PACKAGE_BINUTILS=y
BR2_PACKAGE_BINUTILS_TARGET=y
BR2_PACKAGE_GIT=y
BR2_PACKAGE_PKGCONF=y
BR2_PACKAGE_TREE=y
BR2_PACKAGE_E2FSPROGS=y
BR2_PACKAGE_LM_SENSORS=y
BR2_PACKAGE_ATFTP=y
BR2_PACKAGE_BRIDGE_UTILS=y
BR2_PACKAGE_IPROUTE2=y
BR2_PACKAGE_IPUTILS=y
BR2_PACKAGE_IRSSI=y
BR2_PACKAGE_NETCAT=y
BR2_PACKAGE_NTP=y
BR2_PACKAGE_TRACEROUTE=y
BR2_PACKAGE_WGET=y
BR2_PACKAGE_WHOIS=y
BR2_PACKAGE_XINETD=y
BR2_PACKAGE_NEOFETCH=y
BR2_PACKAGE_HTOP=y
BR2_PACKAGE_TAR=y
BR2_PACKAGE_LESS=y
BR2_PACKAGE_VIM=y
BR2_TARGET_ROOTFS_EXT2=y
BR2_TARGET_ROOTFS_EXT2_4=y
BR2_TARGET_ROOTFS_EXT2_SIZE="120M"
BR2_TARGET_GRUB2=y
BR2_PACKAGE_SBASE=y
BR2_PACKAGE_UBASE=y
BR2_PACKAGE_SMDEV=y
BR2_PACKAGE_NLDEV=y
BR2_PACKAGE_NLMON=y
```

## external-asd2/package/nldev/Config.in
```kconfig
config BR2_PACKAGE_NLDEV
        bool "nldev"
        help
          NetLink DEVice manager; a lightweight netlink frontend for mdev.

          https://r-36.net/scm/nldev/file/README.md.html
```

## external-asd2/package/nlmon/Config.in
```kconfig
config BR2_PACKAGE_NLMON
        bool "nlmon"
        help
          NetLink MONitor; a lightweight udevadm monitor replacement.

          https://r-36.net/scm/nlmon/
```

## external-asd2/package/sbase/Config.in
```kconfig
config BR2_PACKAGE_SBASE
        bool "sbase"
        help
          suckless unix tools

          https://git.suckless.org/sbase/file/README.html
```

## external-asd2/package/sdhcp/Config.in
```kconfig
config BR2_PACKAGE_SDHCP
        bool "sdhcp"
        help
          simple dhcp client

          https://git.2f30.org/sdhcp/
```

## external-asd2/package/sinit/Config.in
```kconfig
config BR2_PACKAGE_SINIT
        bool "sinit"
        help
          suckless init

          https://stagit.suckless.org/sinit/file/README.html

config BR2_PACKAGE_PROVIDES_INIT
    string
    default "sinit" if BR2_INIT_SINIT
    default "busybox" if BR2_INIT_BUSYBOX
    default "systemd" if BR2_INIT_SYSTEMD
    default "openrc" if BR2_INIT_OPENRC
```

## external-asd2/package/skeleton-init-sinit/Config.in
```kconfig
config BR2_PACKAGE_SKELETON_INIT_SINIT
    bool
    select BR2_PACKAGE_HAS_SKELETON
    select BR2_PACKAGE_SKELETON_INIT_COMMON

config BR2_PACKAGE_PROVIDES_SKELETON
    default "skeleton-init-sinit" if BR2_PACKAGE_SKELETON_INIT_SINIT
```

## external-asd2/package/smdev/Config.in
```kconfig
config BR2_PACKAGE_SMDEV
        bool "smdev"
        help
          suckless mdev

          https://git.suckless.org/smdev/file/README.html
```

## external-asd2/package/svc/Config.in
```kconfig
config BR2_PACKAGE_SVC
        bool "svc"
        help
          Simple service scripts and examples, to be used everywhere.

          https://r-36.net/scm/svc/file/README.md.html
```

## external-asd2/package/ubase/Config.in
```kconfig
config BR2_PACKAGE_UBASE
        bool "ubase"
        help
          suckless linux base utils

          https://git.suckless.org/ubase/file/README.html
```
